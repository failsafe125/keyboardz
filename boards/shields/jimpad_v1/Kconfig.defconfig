## boards/shields/jimpad_v1/Kconfig.defconfig
```kconfig
if SHIELD_JIMPAD_V1

config ZMK_KEYBOARD_NAME
    default "jimpad"

config ZMK_BLE
    default y

config ZMK_USB
    default y

config ZMK_KEYSCAN_POLLING_INTERVAL
    default 10

endif # SHIELD_JIMPAD_V1
```

## boards/shields/jimpad_v1/Kconfig.shield
```kconfig
config SHIELD_JIMPAD_V1
    bool "Seeed nRF52840 Custom Shield"
    select ZMK_KEYBOARD
```

## config/west.yml
```yaml
manifest:
  remotes:
    - name: zmk
      url-base: https://github.com/zmkfirmware
  projects:
    - name: zmk
      remote: zmk
      revision: main
    - name: jimpad_v1
      remote: zmk
      path: boards/shields/jimpad_v1  # Set the path to your board definition files
      revision: main
  self:
    path: zmk
```
